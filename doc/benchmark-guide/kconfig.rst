## tests/benchmarks/common/Kconfig
```kconfig
# Copyright (c) 2026 inovex GmbH
# SPDX-License-Identifier: Apache-2.0

# Options that all latency benchmarks share. An app sources this file
# from its own Kconfig.

menu "Latency benchmark common options"

config LATBENCH_SAMPLES
	int "Number of samples in one run"
	default 100000

config LATBENCH_WARMUP
	int "Number of samples to discard at the start"
	default 16

# The board port can give defaults for the symbols below (for example
# LATBENCH_CODE_RAM_REGION). The port file comes first, so that its
# defaults have priority.
orsource "boards/$(BOARD)/Kconfig.port"

choice LATBENCH_CODE_PLACE
	prompt "Place of the code"
	default LATBENCH_CODE_FLASH
	help
	  The latency of code in flash depends on the address of the code
	  (flash wait states, prefetch and cache). Select how the build
	  places the code. The guide (pitfalls, code placement) tells which
	  option to use for which result.

config LATBENCH_CODE_FLASH
	bool "Flash (XIP), one build"
	help
	  All code runs from flash, at the address that the linker gives it.
	  This is the layout of a normal application. The result is valid
	  only for this one build.

config LATBENCH_CODE_FLASH_PAD
	bool "Flash (XIP), moved by a code pad"
	help
	  As LATBENCH_CODE_FLASH, but common/src/pad.c moves all app and
	  kernel code by LATBENCH_CODE_PAD_BYTES. With a pad of 0 the code
	  layout is the layout of LATBENCH_CODE_FLASH. Report an absolute
	  number as the range over a set of pads (an experiment axis).

config LATBENCH_CODE_RAM
	bool "Hot code in RAM"
	select CODE_DATA_RELOCATION
	select CODE_DATA_RELOCATION_SRAM if LATBENCH_CODE_RAM_REGION = "RAM"
	help
	  common/latbench.cmake relocates the code of the hot paths to the
	  RAM region LATBENCH_CODE_RAM_REGION (zephyr_code_relocate()). The
	  startup code copies it from flash. The code of the hot paths then
	  has no flash wait states, and its address has no effect on the
	  latency. Use this option to compare two builds. The board port
	  must give the region.

endchoice

config LATBENCH_CODE_PAD_BYTES
	int "Bytes of code padding before the app and kernel code"
	depends on LATBENCH_CODE_FLASH_PAD || LATBENCH_CODE_RAM
	range 0 1024
	default 0
	help
	  common/src/pad.c puts a function of this size before all other
	  code of the app and the kernel, so that all that code moves by
	  this number of bytes. Use a multiple of 4. With LATBENCH_CODE_RAM
	  the pad is the first function of the relocated code, and it moves
	  only that code.

config LATBENCH_CODE_RAM_REGION
	string "Memory region of the hot code"
	depends on LATBENCH_CODE_RAM
	default ""
	help
	  The LOCATION argument of zephyr_code_relocate(). "RAM" is the
	  region of the zephyr,sram node. Then Zephyr gives the relocated
	  code an MPU region that allows execution
	  (CODE_DATA_RELOCATION_SRAM). Another value must be the name of a
	  devicetree memory region (zephyr,memory-region) that the port adds,
	  and the MPU must allow execution there. This is not tested.
	  The default comes from common/boards/<board>/Kconfig.port. If it is
	  empty, the port has no RAM placement, and the build stops.

config LATBENCH_CODE_RAM_KERNEL
	bool "Relocate the kernel"
	depends on LATBENCH_CODE_RAM
	default y
	help
	  All files of the library "kernel".

config LATBENCH_CODE_RAM_ARCH
	bool "Relocate the arch code"
	depends on LATBENCH_CODE_RAM
	default y
	help
	  The files of the libraries arch__arm__core__cortex_m and
	  arch__arm__core__mpu, without the code that runs before the startup
	  code copies the relocated code (reset.S, prep_c.c, vector_table.S).

config LATBENCH_CODE_RAM_DRIVERS
	bool "Relocate the timer, GPIO and interrupt controller drivers"
	depends on LATBENCH_CODE_RAM
	default y
	help
	  All files of the libraries drivers__timer, drivers__gpio and
	  drivers__interrupt_controller that the build has.

config LATBENCH_CODE_RAM_APP
	bool "Relocate the app and the common benchmark code"
	depends on LATBENCH_CODE_RAM
	default y
	help
	  All files of the library "app": the app, common/src and the board
	  port. The code pad is always relocated.

config LATBENCH_HIST_BINS
	int "Number of 1-cycle histogram bins"
	range 1 65536
	default 4096
	help
	  Values from 0 to LATBENCH_HIST_BINS - 1 go into a bin of their own.
	  Larger values go into log2 overflow bins, and max records the
	  largest one. A value of 2^31 or more is a negative difference. It
	  only counts as invalid.

config LATBENCH_HIST_COARSE_BINS
	int "Number of coarse histogram bins"
	default 0
	help
	  Coarse bins follow the 1-cycle bins. Each one is
	  2^LATBENCH_HIST_COARSE_SHIFT cycles wide. Use them for loads that
	  make long latencies: 2048 fine and 2048 coarse bins of 32 cycles
	  cover 0 to 67583 cycles with the RAM of 4096 fine bins.

config LATBENCH_HIST_COARSE_SHIFT
	int "log2 of the width of a coarse bin"
	range 1 12
	default 5

config LATBENCH_PHASE_BINS
	int "Number of bins of a phase histogram"
	default 64
	help
	  A phase histogram splits the kernel tick into this many bins of
	  equal width. For each bin it records count, min, max and sum of
	  the samples whose stimulus edge had that tick phase.

choice LATBENCH_STIM_MODE
	prompt "Time between two stimuli (apps with the hardware stimulus)"
	default LATBENCH_STIM_RANDOM

config LATBENCH_STIM_RANDOM
	bool "Random"
	help
	  The next edge comes a random time in [LATBENCH_STIM_MIN_US,
	  LATBENCH_STIM_MAX_US) after the code that handled the previous
	  edge armed it. The seed is LATBENCH_STIM_SEED, so each run with
	  the same seed uses the same sequence of delays.

config LATBENCH_STIM_FIXED
	bool "Fixed period"
	help
	  The next edge comes LATBENCH_STIM_PERIOD_US plus
	  LATBENCH_STIM_PERIOD_ADJ_CYC core cycles after the previous edge.
	  The period does not depend on the latency. If the code arms the
	  next edge too late, the stimulus counts an overrun and starts a
	  new period from the time of arming.

endchoice

config LATBENCH_STIM_SEED
	hex "Seed of the random stimulus"
	depends on LATBENCH_STIM_RANDOM
	range 0x1 0xffffffff
	default 0x2545f491
	help
	  Start value of the xorshift32 generator of the random delays (0 is
	  not a valid state). The default is the seed of all runs before
	  this option. The load generators have seeds of their own; they do
	  not change with this option.

config LATBENCH_STIM_PERIOD_US
	int "Period of the fixed stimulus (us)"
	depends on LATBENCH_STIM_FIXED
	default 300
	help
	  On nucleo_g474re TIM2 and the system timer count the same clock. If the period is a
	  whole number of ticks, each edge has the same tick phase. Use
	  LATBENCH_STIM_PERIOD_ADJ_CYC to move the phase.

config LATBENCH_STIM_PERIOD_ADJ_CYC
	int "Cycles added to the period of the fixed stimulus"
	depends on LATBENCH_STIM_FIXED
	range -10000 10000
	default 1
	help
	  The unit is one count of the stimulus timer (a core cycle on
	  nucleo_g474re). With a period of a whole number of ticks, the tick
	  phase of each edge moves by this many counts. 0 keeps the phase constant. A
	  small value scans the full tick slowly: 1 cycle at 170 MHz and
	  10000 ticks/s scans the tick in 17000 edges.

endmenu

menu "Load generators (common/src/load.c)"

config LATBENCH_LOAD_THREADS
	int "Number of load threads"
	range 0 64
	default 0

choice LATBENCH_LOAD_THREAD_KIND
	prompt "What each load thread does"
	default LATBENCH_LOAD_THREAD_BLOCKED

config LATBENCH_LOAD_THREAD_BLOCKED
	bool "Waits forever on a semaphore of its own"

config LATBENCH_LOAD_THREAD_SLEEPER
	bool "Sleeps for a random time, in a loop"
	help
	  Each sleep adds a timeout to the timeout queue, and each wake is
	  a timer expiry and a switch.

config LATBENCH_LOAD_THREAD_BUSY
	bool "Busy loop at the lowest application priority"
	help
	  All busy threads have the same priority. With TIMESLICING=y they
	  take turns at each slice expiry.

endchoice

config LATBENCH_LOAD_THREAD_PRIO
	int "Priority of the blocked and sleeping load threads"
	default 5

config LATBENCH_LOAD_THREAD_STACK
	int "Stack size of a load thread"
	default 384

config LATBENCH_LOAD_SLEEP_MIN_MS
	int "Minimum sleep of a load thread (ms)"
	depends on LATBENCH_LOAD_THREAD_SLEEPER
	default 1

config LATBENCH_LOAD_SLEEP_MAX_MS
	int "Maximum sleep of a load thread (ms)"
	depends on LATBENCH_LOAD_THREAD_SLEEPER
	default 20

config LATBENCH_LOAD_TIMERS
	int "Number of load timers (k_timer)"
	range 0 512
	default 0

choice LATBENCH_LOAD_TIMER_KIND
	prompt "Kind of the load timers"
	default LATBENCH_LOAD_TIMER_PERIODIC

config LATBENCH_LOAD_TIMER_PERIODIC
	bool "Periodic, with random period and start"
	help
	  Each timer gets a period in [LATBENCH_LOAD_TIMER_MIN_MS,
	  LATBENCH_LOAD_TIMER_MAX_MS] and a random first expiry. The expiry
	  function runs in the system timer ISR.

config LATBENCH_LOAD_TIMER_FAR
	bool "One-shot, one hour from the start"
	help
	  The timers stay in the timeout queue for the whole run and never
	  expire. Only the length of the queue changes.

endchoice

config LATBENCH_LOAD_TIMER_MIN_MS
	int "Minimum period of a periodic load timer (ms)"
	depends on LATBENCH_LOAD_TIMER_PERIODIC
	default 10

config LATBENCH_LOAD_TIMER_MAX_MS
	int "Maximum period of a periodic load timer (ms)"
	depends on LATBENCH_LOAD_TIMER_PERIODIC
	default 100

config LATBENCH_SYSTICK_PRIO
	int "IRQ priority of SysTick (-1: the driver default)"
	depends on CORTEX_M_SYSTICK
	default -1
	help
	  A value of 0 or more sets the priority of SysTick at the start of
	  the load, in the numbers of IRQ_CONNECT() (0 is the highest).
	  The driver gives SysTick the same priority as an IRQ with
	  priority 0, and SysTick then goes first. With a value of 1, an
	  IRQ with priority 0 can preempt the SysTick ISR, except in its
	  locked sections. load_print() prints the value that the NVIC
	  has as "systick_prio".

endmenu
```

## tests/benchmarks/common/Kconfig.irqmask
```kconfig
# Copyright (c) 2026 inovex GmbH
# SPDX-License-Identifier: Apache-2.0

# Options of the M4 measurement (common/src/irqmask.c). The measurement is
# on only if the Zephyr tree has CONFIG_ARM_IRQ_MASK_HOOKS (tree
# ws-up-irqoff) and the build sets it. In other builds these options have
# no effect.

menu "M4: interrupt mask time per call site (common/src/irqmask.c)"

config LATBENCH_IRQMASK_SITES_LOG2
	int "log2 of the number of entries in the site table"
	range 4 8
	default 6
	help
	  The table has 2^LATBENCH_IRQMASK_SITES_LOG2 entries. Each entry is
	  one call site, one exception number (0 for a thread) and one kind
	  (mask section or ISR body). If the table is full, a value of a new
	  site counts only in "dropped".

config LATBENCH_IRQMASK_SUB_BITS
	int "log2 of the number of histogram bins in each octave"
	range 2 5
	default 3
	help
	  Values below 2^(LATBENCH_IRQMASK_SUB_BITS + 1) have a bin of 1 cycle
	  each. Each octave above has 2^LATBENCH_IRQMASK_SUB_BITS bins, up to
	  65535 cycles. With 3: 112 bins, 12.5 % of the value or less per
	  bin, 488 bytes per site.

config LATBENCH_IRQMASK_PROBE_CYC
	int "Length of the probe mask section in cycles (0: no probe)"
	default 0
	help
	  A value above 0 starts a probe thread. It masks the interrupts for
	  this number of DWT cycles every LATBENCH_IRQMASK_PROBE_MS. Its site
	  must show this length plus the floor of the calibration. The IRQ
	  tail of the same run must also show it. Use it only to check the
	  method.

config LATBENCH_IRQMASK_PROBE_MS
	int "Period of the probe (ms)"
	default 10

config LATBENCH_IRQMASK_PROBE_PRIO
	int "Priority of the probe thread"
	default 5

endmenu
```

## tests/benchmarks/thread_latency/Kconfig
```kconfig
# Copyright (c) 2026 inovex GmbH
# SPDX-License-Identifier: Apache-2.0

mainmenu "Thread to thread wake latency benchmark"

choice LATBENCH_T2T_PRIMITIVE
	prompt "Kernel object that the giver thread uses to wake the taker"
	default LATBENCH_T2T_SEM

config LATBENCH_T2T_SEM
	bool "k_sem_give / k_sem_take"

config LATBENCH_T2T_MUTEX
	bool "k_mutex_unlock / k_mutex_lock (contended, priority inheritance)"

config LATBENCH_T2T_CONDVAR
	bool "k_condvar_signal / k_condvar_wait"

config LATBENCH_T2T_EVENT
	bool "k_event_post / k_event_wait"
	select EVENTS

config LATBENCH_T2T_MSGQ
	bool "k_msgq_put / k_msgq_get (4-byte message)"

config LATBENCH_T2T_FIFO
	bool "k_fifo_put / k_fifo_get"

config LATBENCH_T2T_LIFO
	bool "k_lifo_put / k_lifo_get"

config LATBENCH_T2T_STACK
	bool "k_stack_push / k_stack_pop"

config LATBENCH_T2T_POLL
	bool "k_poll_signal_raise / k_poll"
	select POLL

config LATBENCH_T2T_WORK
	bool "k_work_submit_to_queue / work handler in a work queue thread"

config LATBENCH_T2T_WAKEUP
	bool "k_wakeup / k_sleep(K_FOREVER)"

endchoice

config LATBENCH_T2T_PREEMPT
	bool "The taker has a higher priority than the giver"
	default y
	help
	  y: the taker (priority 1) preempts the giver (priority 2) in the
	  wake call. n: the taker has priority 3 and runs when the giver
	  blocks again.

config LATBENCH_STIM_MIN_US
	int "Minimum time between two stimuli (us)"
	depends on LATBENCH_STIM_RANDOM
	default 100

config LATBENCH_STIM_MAX_US
	int "Maximum time between two stimuli (us)"
	depends on LATBENCH_STIM_RANDOM
	default 500

config LATBENCH_POLL_MS
	int "Period of the main thread that checks for the end of the run (ms)"
	default 100

rsource "../common/Kconfig"

source "Kconfig.zephyr"
```

## tests/benchmarks/thread_latency/testcase.yaml
```yaml
# Copyright (c) 2026 inovex GmbH
# SPDX-License-Identifier: Apache-2.0

# Build check only. Data points come from scripts/run.py.

common:
  tags:
    - benchmark
    - latency
  platform_allow:
    - nucleo_g474re
    # Build only: these ports never ran on hardware (boards.yaml).
    - nrf52840dk/nrf52840
    - nrf54l15dk/nrf54l15/cpuapp
    - mimxrt1060_evk@C/mimxrt1062/qspi
  build_only: true
tests:
  benchmark.latency.t2t.sem: {}
  benchmark.latency.t2t.sem.nopreempt:
    extra_configs:
      - CONFIG_LATBENCH_T2T_PREEMPT=n
  benchmark.latency.t2t.mutex:
    extra_configs:
      - CONFIG_LATBENCH_T2T_MUTEX=y
  benchmark.latency.t2t.condvar:
    extra_configs:
      - CONFIG_LATBENCH_T2T_CONDVAR=y
  benchmark.latency.t2t.event:
    extra_configs:
      - CONFIG_LATBENCH_T2T_EVENT=y
  benchmark.latency.t2t.msgq:
    extra_configs:
      - CONFIG_LATBENCH_T2T_MSGQ=y
  benchmark.latency.t2t.fifo:
    extra_configs:
      - CONFIG_LATBENCH_T2T_FIFO=y
  benchmark.latency.t2t.lifo:
    extra_configs:
      - CONFIG_LATBENCH_T2T_LIFO=y
  benchmark.latency.t2t.stack:
    extra_configs:
      - CONFIG_LATBENCH_T2T_STACK=y
  benchmark.latency.t2t.poll:
    extra_configs:
      - CONFIG_LATBENCH_T2T_POLL=y
  benchmark.latency.t2t.work:
    extra_configs:
      - CONFIG_LATBENCH_T2T_WORK=y
  benchmark.latency.t2t.wakeup:
    extra_configs:
      - CONFIG_LATBENCH_T2T_WAKEUP=y
```

## tests/benchmarks/wake_latency/testcase.yaml
```yaml
# Copyright (c) 2026 inovex GmbH
# SPDX-License-Identifier: Apache-2.0

# Build check only. Data points come from scripts/run.py.

common:
  tags:
    - benchmark
    - latency
  platform_allow:
    - nucleo_g474re
    # Build only: these ports never ran on hardware (boards.yaml).
    - nrf52840dk/nrf52840
    - nrf54l15dk/nrf54l15/cpuapp
    - mimxrt1060_evk@C/mimxrt1062/qspi
  build_only: true
tests:
  benchmark.latency.wake.sem: {}
  benchmark.latency.wake.sem.direct:
    extra_configs:
      - CONFIG_LATBENCH_WAKE_ISR_DIRECT=y
  benchmark.latency.wake.event:
    extra_configs:
      - CONFIG_LATBENCH_WAKE_EVENT=y
  benchmark.latency.wake.msgq:
    extra_configs:
      - CONFIG_LATBENCH_WAKE_MSGQ=y
  benchmark.latency.wake.fifo:
    extra_configs:
      - CONFIG_LATBENCH_WAKE_FIFO=y
  benchmark.latency.wake.poll:
    extra_configs:
      - CONFIG_LATBENCH_WAKE_POLL=y
```
