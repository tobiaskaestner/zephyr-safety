## CMakeLists.txt
```
# Copyright (c) 2026 inovex GmbH
# SPDX-License-Identifier: Apache-2.0

cmake_minimum_required(VERSION 3.20.0)

# The stock path (the default) uses the GPIO driver. The other paths
# connect their own ISR, so the port must take the response interrupt
# away from the GPIO driver. This needs the path on the command line
# (-DCONFIG_LATBENCH_IRQ_PATH_...=y); main.c checks that both agree.
set(LATBENCH_RESP_IRQ_OWN_IF
  CONFIG_LATBENCH_IRQ_PATH_WRAPPED CONFIG_LATBENCH_IRQ_PATH_DIRECT CONFIG_LATBENCH_IRQ_PATH_ZLI)
include(${CMAKE_CURRENT_SOURCE_DIR}/../common/latbench_board.cmake)

find_package(Zephyr REQUIRED HINTS $ENV{ZEPHYR_BASE})
project(irq_latency)

set(LATBENCH_STIM ON)
include(${CMAKE_CURRENT_SOURCE_DIR}/../common/latbench.cmake)
target_sources(app PRIVATE src/main.c)
# The scenarios other than the entry (LATBENCH_IRQ_SCENARIO). Only with
# such a scenario, so that the entry images do not change.
if(NOT CONFIG_LATBENCH_IRQ_SCEN_ENTRY)
  target_sources(app PRIVATE src/scenario.c)
endif()
```

## Kconfig
```
# Copyright (c) 2026 inovex GmbH
# SPDX-License-Identifier: Apache-2.0

mainmenu "IRQ latency benchmark"

choice LATBENCH_IRQ_PATH
	prompt "Interrupt path from the response pin to the measurement point"
	default LATBENCH_IRQ_PATH_STOCK

config LATBENCH_IRQ_PATH_STOCK
	bool "GPIO driver callback"
	help
	  The EXTI driver owns the IRQ. The time stamp is in the user
	  callback, after _isr_wrapper and the driver dispatch.

config LATBENCH_IRQ_PATH_WRAPPED
	bool "Own ISR through _isr_wrapper (IRQ_CONNECT)"
	help
	  Set it on the cmake command line, so that the board port gives the
	  response IRQ to the app.

config LATBENCH_IRQ_PATH_DIRECT
	bool "Own direct ISR (IRQ_DIRECT_CONNECT)"
	help
	  Set it on the cmake command line, so that the board port gives the
	  response IRQ to the app.

config LATBENCH_IRQ_PATH_ZLI
	bool "Own direct zero-latency ISR"
	select ZERO_LATENCY_IRQS
	help
	  Set it on the cmake command line, so that the board port gives the
	  response IRQ to the app. BASEPRI does not mask this IRQ, so
	  kernel critical sections do not delay it.

endchoice

choice LATBENCH_BACKGROUND
	prompt "What the CPU does between the stimuli"
	default LATBENCH_BG_IDLE

config LATBENCH_BG_IDLE
	bool "Idle thread (WFI)"

config LATBENCH_BG_BUSY
	bool "Busy thread at the lowest priority"

endchoice

config LATBENCH_STIM_MIN_US
	int "Minimum time between two stimuli (us)"
	depends on LATBENCH_STIM_RANDOM
	default 200

config LATBENCH_STIM_MAX_US
	int "Maximum time between two stimuli (us)"
	depends on LATBENCH_STIM_RANDOM
	default 1000
	help
	  The time between two stimuli is random in [MIN, MAX), so the
	  stimuli do not lock to the phase of the system timer.

choice LATBENCH_IRQ_SCENARIO
	prompt "Scenario"
	default LATBENCH_IRQ_SCEN_ENTRY
	help
	  What the app measures. The scenarios other than the entry come
	  from the upstream interrupt benchmark (Zephyr PR 117170). They need
	  the path wrapped or direct. In these scenarios the main thread
	  drives each sample and spins between the samples. See
	  src/scenario.c and the documentation of the app.

config LATBENCH_IRQ_SCEN_ENTRY
	bool "Entry: edge to the ISR"
	help
	  The ISR arms the next edge. Histogram irq.

config LATBENCH_IRQ_SCEN_UNLOCK
	bool "irq_unlock() to the ISR of a pending edge"
	help
	  The main thread locks the interrupts before the edge, waits until
	  the edge is pending in the NVIC, holds the lock for
	  LATBENCH_UNLOCK_HOLD_US after the edge, reads the timer (t0) and
	  calls irq_unlock(). Histogram irq_unlock: ISR time stamp - t0.

config LATBENCH_IRQ_SCEN_NESTED
	bool "Entry of the edge ISR in a lower-priority ISR"
	help
	  Before the edge, the main thread pends a spare IRQ of the port at
	  the priority LATBENCH_NESTED_PRIO. Its ISR spins until the edge ISR
	  preempted it. Histogram irq_nested: edge to the ISR time stamp.
	  Then the spare ISR reads the timer (t0) and pends the response IRQ
	  with NVIC STIR, as the upstream scenario does. Histogram
	  irq_nested_sw: t0 to the ISR time stamp.

config LATBENCH_IRQ_SCEN_EXIT
	bool "Exit: end of the ISR to the interrupted thread"
	help
	  The main thread spins on a flag. The ISR sets the flag and reads
	  the timer as its last action (t_exit). Histogram irq_exit: the
	  time stamp of the thread after the spin - t_exit. Histogram irq:
	  the entry, from a busy thread.

config LATBENCH_IRQ_SCEN_BURST
	bool "Back to back: ISR entry to the next ISR entry"
	help
	  The edge starts a burst of LATBENCH_BURST_LEN ISR runs. The ISR
	  pends its own IRQ again with NVIC STIR just after its time stamp.
	  Histogram irq_b2b: time stamp to the next time stamp (the cost of
	  one ISR in a burst). Histogram irq: the edge to the first ISR.

endchoice

config LATBENCH_UNLOCK_HOLD_US
	int "Lock time after the edge (us)"
	depends on LATBENCH_IRQ_SCEN_UNLOCK
	range 0 1000
	default 10

config LATBENCH_NESTED_PRIO
	int "Priority of the lower-priority ISR"
	depends on LATBENCH_IRQ_SCEN_NESTED
	range 1 14
	default 1
	help
	  The response IRQ has the priority 0, so the edge ISR preempts the
	  spare ISR.

config LATBENCH_BURST_LEN
	int "ISR runs in one burst"
	depends on LATBENCH_IRQ_SCEN_BURST
	range 2 64
	default 16

config LATBENCH_POLL_MS
	int "Period of the main thread that checks for the end of the run (ms)"
	default 100

rsource "../common/Kconfig"

source "Kconfig.zephyr"
```

## prj.conf
```kconfig
# Copyright (c) 2026 inovex GmbH
# SPDX-License-Identifier: Apache-2.0

CONFIG_GPIO=y
CONFIG_PRINTK=y

# Set the debug options explicitly, because the two Zephyr trees have
# different defaults (WP2 finding 5).
CONFIG_ASSERT=n
CONFIG_SPIN_VALIDATE=n
```

## exti_line0_app.overlay
```dts
/*
 * Copyright (c) 2026 inovex GmbH
 *
 * SPDX-License-Identifier: Apache-2.0
 *
 * Take EXTI line 0 (IRQ 6) away from the GPIO interrupt driver, so that
 * the app can connect its own ISR to it. Same as stm32g4.dtsi without
 * the "line0" entry.
 */

&exti {
	interrupts = <7 0>, <8 0>, <9 0>, <10 0>, <23 0>, <40 0>;
	interrupt-names = "line1", "line2-TSC", "line3", "line4",
			  "line5-9", "line10-15";
	line-ranges = <1 1>, <2 1>, <3 1>, <4 1>, <5 5>, <10 6>;
};
```

## boards/nucleo_g474re.overlay
```dts
/*
 * Copyright (c) 2026 inovex GmbH
 *
 * SPDX-License-Identifier: Apache-2.0
 *
 * Loopback wire D2 (PA10) -> A3 (PB0, EXTI line 0).
 * TIM2 channel 4 drives PA10 by output compare. TIM2 runs at the core
 * clock, so CNT - CCR4 in the ISR is the latency in core cycles.
 */
#include <zephyr/dt-bindings/gpio/gpio.h>
#include <zephyr/dt-bindings/gpio/arduino-header-r3.h>

/ {
	zephyr,user {
		resp-gpios = <&arduino_header ARDUINO_HEADER_R3_A3 GPIO_ACTIVE_HIGH>;
		pinctrl-0 = <&tim2_ch4_pa10>;
		pinctrl-names = "default";
	};
};

/* The board uses TIM2 for the LED PWM on PA5. The benchmark owns TIM2. */
&pwm2 {
	status = "disabled";
};
```

## src/main.c
```c
/*
 * Copyright (c) 2026 inovex GmbH
 *
 * SPDX-License-Identifier: Apache-2.0
 */

/*
 * IRQ latency benchmark (measurement point M1 of the latency plan).
 *
 * The stimulus timer of the board port sets the stimulus pin high when
 * its counter reaches the compare value. A wire takes the edge to the
 * response pin. The measurement point reads the counter, so counter -
 * compare value is the time from the edge to the measurement point (in
 * core cycles, if the timer runs at the core clock, as on nucleo_g474re).
 * The time stamp of the edge comes from hardware, and the timer counts
 * also while the core sleeps in WFI. See latbench/stim.h and
 * latbench/port.h.
 *
 * The measurement point schedules the next stimulus (random or fixed
 * rate). A second histogram records the latency by the tick phase of the
 * edge.
 */

#include <zephyr/kernel.h>
#include <zephyr/irq.h>
#include <zephyr/drivers/gpio.h>
#include <zephyr/sys/printk.h>

#include <latbench/hist.h>
#include <latbench/load.h>
#include <latbench/meta.h>
#include <latbench/stim.h>
#include <latbench/swtrig.h>
#include <latbench/tail.h>

#if defined(CONFIG_LATBENCH_IRQ_PATH_STOCK)
#define IRQ_PATH "stock"
BUILD_ASSERT(!PORT_RESP_IRQ_OWNED, "the stock path needs the response IRQ in the GPIO driver");
#else
BUILD_ASSERT(PORT_RESP_IRQ_OWNED,
	     "the own ISR paths need -DCONFIG_LATBENCH_IRQ_PATH_<path>=y on the cmake command line");
#if defined(CONFIG_LATBENCH_IRQ_PATH_WRAPPED)
#define IRQ_PATH "wrapped"
#elif defined(CONFIG_LATBENCH_IRQ_PATH_DIRECT)
#define IRQ_PATH "direct"
#else
#define IRQ_PATH "zli"
#endif
#endif

#if !defined(CONFIG_LATBENCH_IRQ_SCEN_ENTRY)
/* The main thread of the scenario spins (src/scenario.c). */
#define BACKGROUND "scenario"
#elif defined(CONFIG_LATBENCH_BG_BUSY)
#define BACKGROUND "busy"
#else
#define BACKGROUND "idle"
#endif

#define N_TOTAL (CONFIG_LATBENCH_WARMUP + CONFIG_LATBENCH_SAMPLES)

#if defined(CONFIG_LATBENCH_IRQ_SCEN_ENTRY)

static LAT_HIST_DEFINE(hist, "irq");
static LAT_PHASE_DEFINE(phase, "irq");

#if defined(CONFIG_LATBENCH_SWTRIG)
BUILD_ASSERT(IS_ENABLED(CONFIG_LATBENCH_IRQ_PATH_WRAPPED) || IS_ENABLED(CONFIG_LATBENCH_IRQ_PATH_DIRECT),
	     "LATBENCH_SWTRIG needs the wrapped or the direct path: the GPIO driver of the stock path "
	     "does not see a software pend, and a ZLI must not call k_sem_give()");
/* The software samples: STIR store -> first instruction of the ISR. */
static LAT_HIST_DEFINE(hist_sw, "irq_sw");
static LAT_PHASE_DEFINE(phase_sw, "irq_sw");
static uint32_t n_sw_seen;
#endif

#if defined(CONFIG_LATBENCH_TAIL)
/* Witnesses of the largest edge samples. The window starts at the arm of the edge. */
LAT_TAIL_DEFINE(tail, "irq");
static struct lat_tail_mark tail_m;
#define TAIL_MARK() lat_tail_mark(&tail_m)

/*
 * Not inline, with two arguments: the ISR then needs no more registers,
 * and its code before the time stamp stays the same as without witnesses.
 */
static __noinline void tail_add(uint32_t n, uint32_t lat)
{
	lat_tail_add(&tail, &tail_m, n - CONFIG_LATBENCH_WARMUP, lat, 0U, stim_edge_phase(),
		     LAT_TAIL_ISR_CTX);
}
#else
#define TAIL_MARK()
#endif

static volatile uint32_t n_seen;
static volatile uint32_t n_spurious;
static volatile bool done;

/*
 * Note for the ZLI path: stim_arm() takes the tick phase of the next edge
 * from k_cycle_get_64(). BASEPRI does not mask a zero-latency IRQ, so the
 * read can interrupt the timer driver in its locked section and see an
 * inconsistent count. Only the phase histogram is at risk, not the
 * latency.
 */
static inline void on_edge(uint32_t now)
{
	uint32_t n = n_seen;

#if defined(CONFIG_LATBENCH_SWTRIG)
	/* A software sample: the trigger thread records it. */
	if (swtrig_take(now)) {
		return;
	}
#endif
	/* An edge without a timer compare match did not come from the stimulus. */
	if (!stim_fired()) {
		n_spurious++;
	}
	if (n >= CONFIG_LATBENCH_WARMUP) {
		uint32_t lat = now - stim_edge();

		lat_hist_add(&hist, lat);
		lat_phase_add(&phase, stim_edge_phase(), lat);
#if defined(CONFIG_LATBENCH_TAIL)
		/* After the time stamp: the sample is complete. */
		tail_add(n, lat);
#endif
	}
	n_seen = ++n;
#if defined(CONFIG_LATBENCH_SWTRIG)
	/* A software sample follows each edge sample. sw_done() arms the next edge. */
	ARG_UNUSED(now);
	swtrig_request();
#else
	if (n < N_TOTAL) {
		TAIL_MARK();
		stim_arm(now);
	} else {
		stim_stop();
		done = true;
	}
#endif
}

#if defined(CONFIG_LATBENCH_SWTRIG)
/* In the trigger thread, after the ISR took the software sample. */
static void sw_done(uint32_t t0, uint32_t t_isr)
{
	uint32_t m = n_sw_seen;

	if (m >= CONFIG_LATBENCH_WARMUP) {
		uint32_t lat = t_isr - t0;

		lat_hist_add(&hist_sw, lat);
		lat_phase_add(&phase_sw, stim_phase_of(t0), lat);
	}
	n_sw_seen = ++m;
	if (n_seen < N_TOTAL) {
		TAIL_MARK();
		stim_arm(stim_now());
	} else {
		stim_stop();
		done = true;
	}
}
#endif

#if defined(CONFIG_LATBENCH_IRQ_PATH_STOCK)

static struct gpio_callback resp_cb;

static void resp_handler(const struct device *dev, struct gpio_callback *cb, uint32_t pins)
{
	on_edge(stim_now());
}

static int irq_setup(void)
{
	gpio_init_callback(&resp_cb, resp_handler, BIT(stim_resp.pin));
	gpio_add_callback_dt(&stim_resp, &resp_cb);
	return gpio_pin_interrupt_configure_dt(&stim_resp, GPIO_INT_EDGE_TO_ACTIVE);
}

#else /* own ISR on the response IRQ */

#if defined(CONFIG_LATBENCH_IRQ_PATH_WRAPPED)

static void resp_isr(const void *arg)
{
	uint32_t now = stim_now();

	ARG_UNUSED(arg);
	stim_resp_ack();
	on_edge(now);
}

#else

ISR_DIRECT_DECLARE(resp_isr)
{
	uint32_t now = stim_now();

	stim_resp_ack();
	on_edge(now);
#if defined(CONFIG_LATBENCH_SWTRIG)
	/* on_edge() can wake the trigger thread: ask for a reschedule at the exit. */
	return 1;
#else
	return 0;
#endif
}

#endif

static int irq_setup(void)
{
#if defined(PORT_RESP_PIN)
	/* The own ISR serves only the pin that the port sets up. */
	if (stim_resp.pin != PORT_RESP_PIN) {
		return -EINVAL;
	}
#endif

	stim_resp_irq_init();
#if defined(CONFIG_LATBENCH_IRQ_PATH_WRAPPED)
	IRQ_CONNECT(STIM_RESP_IRQN, 0, resp_isr, NULL, 0);
#elif defined(CONFIG_LATBENCH_IRQ_PATH_DIRECT)
	IRQ_DIRECT_CONNECT(STIM_RESP_IRQN, 0, resp_isr, 0);
#else
	IRQ_DIRECT_CONNECT(STIM_RESP_IRQN, 0, resp_isr, IRQ_ZERO_LATENCY);
#endif
	irq_enable(STIM_RESP_IRQN);
	return 0;
}

#endif

#if defined(CONFIG_LATBENCH_BG_BUSY)
static void busy_fn(void *a, void *b, void *c)
{
	for (;;) {
		arch_nop();
	}
}

K_THREAD_DEFINE(busy_tid, 512, busy_fn, NULL, NULL, NULL, K_LOWEST_APPLICATION_THREAD_PRIO, 0,
		0);
#endif

#else /* another scenario: src/scenario.c */
#include "scenario.h"
#endif

int main(void)
{
	char buf[24];

	/* Undo debugger settings that keep clocks on in sleep (see the port). */
	port_debug_reset(buf, sizeof(buf));

	lat_meta_print("irq_latency", IRQ_PATH);
	lat_meta_kv("irq_path", IRQ_PATH);
	lat_meta_kv("background", BACKGROUND);
	lat_meta_kv("debug_reg_at_boot", buf);
	printk("LAT META poll_ms=%u\n", CONFIG_LATBENCH_POLL_MS);

	if (stim_init() < 0) {
		printk("LAT ERROR setup\n");
		lat_done();
		return 0;
	}
#if !defined(CONFIG_LATBENCH_IRQ_SCEN_ENTRY)
	scen_main();
	lat_done();
	return 0;
#else
	lat_phase_init(&phase, stim_tick_period());
#if defined(CONFIG_LATBENCH_SWTRIG)
	lat_phase_init(&phase_sw, stim_tick_period());
#endif
	if (!stim_static_check()) {
		printk("LAT ERROR static check failed (wire D2 -> A3?)\n");
		lat_done();
		return 0;
	}
	if (irq_setup() < 0) {
		printk("LAT ERROR irq setup\n");
		lat_done();
		return 0;
	}

#if defined(CONFIG_LATBENCH_TAIL)
	lat_tail_init();
	lat_tail_print_setup(&tail);
#endif
	load_start();
#if defined(CONFIG_LATBENCH_SWTRIG)
	/* Above the busy thread, below the main thread. */
	swtrig_start(1, sw_done);
	swtrig_print_setup();
#endif
	TAIL_MARK();
	stim_arm(stim_now());
	while (!done) {
		k_msleep(CONFIG_LATBENCH_POLL_MS);
	}

	printk("LAT META spurious_edges=%u\n", n_spurious);
	stim_print_stats();
	load_print();
	lat_hist_print(&hist);
	lat_phase_print(&phase);
#if defined(CONFIG_LATBENCH_TAIL)
	lat_tail_print(&tail);
#endif
#if defined(CONFIG_LATBENCH_SWTRIG)
	swtrig_print_stats();
	lat_hist_print(&hist_sw);
	lat_phase_print(&phase_sw);
#endif
	lat_done();
	return 0;
#endif
}
```

## src/scenario.c
```c
/*
 * Copyright (c) 2026 inovex GmbH
 *
 * SPDX-License-Identifier: Apache-2.0
 */

/*
 * The scenarios of irq_latency other than the entry
 * (LATBENCH_IRQ_SCENARIO). They come from the upstream interrupt benchmark
 * (Zephyr PR 117170): unlock to ISR, nested preemption, exit to the
 * interrupted thread, back to back. CMakeLists.txt adds this file only
 * with such a scenario, so the images of the entry do not change.
 *
 * The main thread drives each sample: it arms the edge, does the part of
 * the scenario before the edge, waits for the ISR and records the sample.
 * Between the samples it spins (no WFI). The edge keeps its random time,
 * so the samples keep a random tick phase.
 */

#include <zephyr/kernel.h>
#include <zephyr/irq.h>
#include <zephyr/sys/printk.h>
#include <cmsis_core.h>

#include <latbench/hist.h>
#include <latbench/load.h>
#include <latbench/stim.h>
#include <latbench/tail.h>

#include "scenario.h"

BUILD_ASSERT(IS_ENABLED(CONFIG_LATBENCH_IRQ_PATH_WRAPPED) || IS_ENABLED(CONFIG_LATBENCH_IRQ_PATH_DIRECT),
	     "the scenarios need the wrapped or the direct path");
BUILD_ASSERT(!IS_ENABLED(CONFIG_LATBENCH_SWTRIG), "LATBENCH_SWTRIG is for the entry scenario only");
BUILD_ASSERT(IS_ENABLED(CONFIG_LATBENCH_BG_IDLE),
	     "in the scenarios the main thread spins: a busy thread never runs");

#define N_TOTAL (CONFIG_LATBENCH_WARMUP + CONFIG_LATBENCH_SAMPLES)

/* The main thread starts the part of a sample that needs the edge this many us before the edge. */
#define LEAD_US 20
/* A wait that is longer than this many ms is a timeout (a lost interrupt). */
#define TIMEOUT_MS 20
/* Stop after this many samples that did not fit the scenario. */
#define MAX_MISSED 10000U

#if defined(CONFIG_LATBENCH_IRQ_SCEN_UNLOCK)
#define SCEN_NAME "unlock"
#define MAIN_NAME "irq_unlock"
#elif defined(CONFIG_LATBENCH_IRQ_SCEN_NESTED)
#define SCEN_NAME "nested"
#define MAIN_NAME "irq_nested"
#if !defined(PORT_SPARE_IRQN)
#error "the scenario nested needs PORT_SPARE_IRQN of the board port"
#endif
#elif defined(CONFIG_LATBENCH_IRQ_SCEN_EXIT)
#define SCEN_NAME "exit"
#define MAIN_NAME "irq_exit"
#else
#define SCEN_NAME "burst"
#define MAIN_NAME "irq_b2b"
#endif

#if defined(CONFIG_LATBENCH_IRQ_SCEN_BURST)
/* The phase histogram has the first entry of each burst. */
#define PHASE_NAME "irq"
#else
#define PHASE_NAME MAIN_NAME
#endif

/* The main histogram of the scenario, and its phase histogram (by the tick phase of the edge). */
static LAT_HIST_DEFINE(h_main, MAIN_NAME);
static LAT_PHASE_DEFINE(p_main, PHASE_NAME);
#if defined(CONFIG_LATBENCH_IRQ_SCEN_EXIT) || defined(CONFIG_LATBENCH_IRQ_SCEN_BURST)
/* The entry from the spinning main thread: edge to the first ISR time stamp. */
static LAT_HIST_DEFINE(h_irq, "irq");
#endif
#if defined(CONFIG_LATBENCH_IRQ_SCEN_NESTED)
/* STIR store in the lower-priority ISR to the ISR time stamp (the upstream span). */
static LAT_HIST_DEFINE(h_sw, "irq_nested_sw");
#endif

#if defined(CONFIG_LATBENCH_TAIL)
/* Witnesses of the main histogram. The window starts at the arm of the edge. */
LAT_TAIL_DEFINE(tail, MAIN_NAME);
static struct lat_tail_mark tail_m;
#define TAIL_MARK() lat_tail_mark(&tail_m)
#define TAIL_ADD(seq, lat, aux)                                                                    \
	lat_tail_add(&tail, &tail_m, (seq), (lat), (aux), stim_edge_phase(), LAT_TAIL_NO_CTX)
#else
#define TAIL_MARK()
#define TAIL_ADD(seq, lat, aux)
#endif

/* Set by the ISR of the edge (of the last ISR of a burst). */
static volatile bool flag;
/* Time stamp of the ISR of the edge. */
static volatile uint32_t t_isr;
static volatile uint32_t n_spurious;
static uint32_t n_missed;
static uint32_t n_timeouts;
static uint32_t lead_cyc;
static uint32_t timeout_cyc;

#if defined(CONFIG_LATBENCH_IRQ_SCEN_EXIT)
/* The last time stamp of the ISR. */
static volatile uint32_t t_exit;
#endif

#if defined(CONFIG_LATBENCH_IRQ_SCEN_NESTED)
/* The lower-priority ISR runs. */
static volatile bool in_low;
/* The edge ISR preempted the lower-priority ISR. */
static volatile bool nested_ok;
static volatile bool low_done;
static volatile bool sw_pending;
static volatile uint32_t t0_sw;
static volatile uint32_t t_isr_sw;
#endif

#if defined(CONFIG_LATBENCH_IRQ_SCEN_BURST)
static volatile uint32_t b_k;
static volatile uint32_t b_stamps[CONFIG_LATBENCH_BURST_LEN];
#endif

/* Spin until cond is true, or count a timeout. */
#define SPIN_UNTIL(cond)                                                                           \
	do {                                                                                       \
		uint32_t start_ = stim_now();                                                      \
		while (!(cond)) {                                                                  \
			if ((uint32_t)(stim_now() - start_) > timeout_cyc) {                       \
				n_timeouts++;                                                      \
				break;                                                             \
			}                                                                          \
		}                                                                                  \
	} while (0)

#if defined(CONFIG_LATBENCH_IRQ_SCEN_UNLOCK) || defined(CONFIG_LATBENCH_IRQ_SCEN_NESTED)
/* Spin until LEAD_US before the edge. */
static void lead_wait(void)
{
	while ((int32_t)(stim_edge() - stim_now()) > (int32_t)lead_cyc) {
	}
}
#endif

/* The ISR of the response IRQ, after its time stamp now. */
static inline void resp_body(uint32_t now)
{
#if defined(CONFIG_LATBENCH_IRQ_SCEN_BURST)
	uint32_t i = b_k;

	/* Pend the next run first, as the upstream scenario (it re-triggers at the top). */
	if (i + 1U < CONFIG_LATBENCH_BURST_LEN) {
		NVIC->STIR = STIM_RESP_IRQN;
	}
	b_stamps[i] = now;
	b_k = i + 1U;
	stim_resp_ack();
	if (i == 0U && !stim_fired()) {
		n_spurious++;
	}
	if (i + 1U >= CONFIG_LATBENCH_BURST_LEN) {
		flag = true;
	}
#else
	stim_resp_ack();
#if defined(CONFIG_LATBENCH_IRQ_SCEN_NESTED)
	if (sw_pending) {
		/* The software part of the sample: no edge. */
		t_isr_sw = now;
		sw_pending = false;
		return;
	}
	nested_ok = in_low;
#endif
	if (!stim_fired()) {
		n_spurious++;
	}
	t_isr = now;
	flag = true;
#if defined(CONFIG_LATBENCH_IRQ_SCEN_EXIT)
	/* The last action of the ISR. */
	t_exit = stim_now();
#endif
#endif
}

#if defined(CONFIG_LATBENCH_IRQ_PATH_WRAPPED)
static void resp_isr(const void *arg)
{
	uint32_t now = stim_now();

	ARG_UNUSED(arg);
	resp_body(now);
}
#else
ISR_DIRECT_DECLARE(resp_isr)
{
	uint32_t now = stim_now();

	resp_body(now);
	/* No reschedule: the ISR wakes no thread. */
	return 0;
}
#endif

#if defined(CONFIG_LATBENCH_IRQ_SCEN_NESTED)
/*
 * The lower-priority ISR. It spins until the edge ISR preempted it. Then
 * it reads the timer and pends the response IRQ with STIR, as the upstream
 * scenario nested_preempt does, and spins until that ISR ran too.
 */
static void low_isr(const void *arg)
{
	ARG_UNUSED(arg);
	in_low = true;
	SPIN_UNTIL(flag);
	sw_pending = true;
	t0_sw = stim_now();
	NVIC->STIR = STIM_RESP_IRQN;
	SPIN_UNTIL(!sw_pending);
	in_low = false;
	low_done = true;
}
#endif

static int scen_irq_setup(void)
{
#if defined(PORT_RESP_PIN)
	if (stim_resp.pin != PORT_RESP_PIN) {
		return -EINVAL;
	}
#endif
	stim_resp_irq_init();
#if defined(CONFIG_LATBENCH_IRQ_PATH_WRAPPED)
	IRQ_CONNECT(STIM_RESP_IRQN, 0, resp_isr, NULL, 0);
#else
	IRQ_DIRECT_CONNECT(STIM_RESP_IRQN, 0, resp_isr, 0);
#endif
	irq_enable(STIM_RESP_IRQN);
#if defined(CONFIG_LATBENCH_IRQ_SCEN_NESTED)
	IRQ_CONNECT(PORT_SPARE_IRQN, CONFIG_LATBENCH_NESTED_PRIO, low_isr, NULL, 0);
	irq_enable(PORT_SPARE_IRQN);
#endif
	return 0;
}

/* One sample. Returns false if the sample did not fit the scenario (not recorded). */
static bool sample(bool rec, uint32_t seq)
{
#if defined(CONFIG_LATBENCH_IRQ_SCEN_UNLOCK)
	unsigned int key;
	uint32_t hold = CONFIG_LATBENCH_UNLOCK_HOLD_US * (port_stim_hz() / 1000000U);
	uint32_t t0;

	flag = false;
	TAIL_MARK();
	stim_arm(stim_now());
	lead_wait();
	key = irq_lock();
	if (flag) {
		/* The edge came before the lock (a long ISR in the lead time). */
		irq_unlock(key);
		return false;
	}
	/* The edge is pending in the NVIC, and the lock holds it. */
	SPIN_UNTIL(NVIC_GetPendingIRQ(STIM_RESP_IRQN) != 0U);
	SPIN_UNTIL((uint32_t)(stim_now() - stim_edge()) >= hold);
	t0 = stim_now();
	irq_unlock(key);
	SPIN_UNTIL(flag);
	if (rec) {
		uint32_t lat = t_isr - t0;

		lat_hist_add(&h_main, lat);
		lat_phase_add(&p_main, stim_edge_phase(), lat);
		TAIL_ADD(seq, lat, t0 - stim_edge());
	}
#elif defined(CONFIG_LATBENCH_IRQ_SCEN_NESTED)
	flag = false;
	low_done = false;
	nested_ok = false;
	TAIL_MARK();
	stim_arm(stim_now());
	lead_wait();
	NVIC->STIR = PORT_SPARE_IRQN;
	SPIN_UNTIL(low_done);
	if (!nested_ok) {
		/* The edge did not meet the lower-priority ISR. */
		return false;
	}
	if (rec) {
		uint32_t lat = t_isr - stim_edge();

		lat_hist_add(&h_main, lat);
		lat_phase_add(&p_main, stim_edge_phase(), lat);
		lat_hist_add(&h_sw, t_isr_sw - t0_sw);
		TAIL_ADD(seq, lat, t_isr_sw - t0_sw);
	}
#elif defined(CONFIG_LATBENCH_IRQ_SCEN_EXIT)
	uint32_t t_thr;

	flag = false;
	TAIL_MARK();
	stim_arm(stim_now());
	/* A tight loop, as the upstream scenario: the ISR returns into it. */
	while (!flag) {
	}
	t_thr = stim_now();
	if (rec) {
		uint32_t lat = t_thr - t_exit;

		lat_hist_add(&h_irq, t_isr - stim_edge());
		lat_hist_add(&h_main, lat);
		lat_phase_add(&p_main, stim_edge_phase(), lat);
		TAIL_ADD(seq, lat, t_isr - stim_edge());
	}
#else /* burst */
	flag = false;
	b_k = 0U;
	TAIL_MARK();
	stim_arm(stim_now());
	while (!flag) {
	}
	if (rec) {
		lat_hist_add(&h_irq, b_stamps[0] - stim_edge());
		lat_phase_add(&p_main, stim_edge_phase(), b_stamps[0] - stim_edge());
		for (uint32_t i = 1U; i < CONFIG_LATBENCH_BURST_LEN; i++) {
			uint32_t lat = b_stamps[i] - b_stamps[i - 1U];

			lat_hist_add(&h_main, lat);
			TAIL_ADD(seq * (CONFIG_LATBENCH_BURST_LEN - 1U) + i - 1U, lat, i);
		}
	}
#endif
	return true;
}

void scen_main(void)
{
	uint32_t n = 0U;

	lat_phase_init(&p_main, stim_tick_period());
	if (!stim_static_check()) {
		printk("LAT ERROR static check failed (wire D2 -> A3?)\n");
		return;
	}
	if (scen_irq_setup() < 0) {
		printk("LAT ERROR irq setup\n");
		return;
	}
	lead_cyc = LEAD_US * (port_stim_hz() / 1000000U);
	timeout_cyc = TIMEOUT_MS * (port_stim_hz() / 1000U);
	printk("LAT META irq_scenario=%s\n", SCEN_NAME);
	printk("LAT META scen_lead_us=%u\n", LEAD_US);
#if defined(CONFIG_LATBENCH_IRQ_SCEN_UNLOCK)
	printk("LAT META unlock_hold_us=%u\n", CONFIG_LATBENCH_UNLOCK_HOLD_US);
#elif defined(CONFIG_LATBENCH_IRQ_SCEN_NESTED)
	printk("LAT META nested_prio=%u\n", CONFIG_LATBENCH_NESTED_PRIO);
	printk("LAT META spare_irqn=%d\n", (int)PORT_SPARE_IRQN);
#elif defined(CONFIG_LATBENCH_IRQ_SCEN_BURST)
	printk("LAT META burst_len=%u\n", CONFIG_LATBENCH_BURST_LEN);
#endif
#if defined(CONFIG_LATBENCH_TAIL)
	lat_tail_init();
	lat_tail_print_setup(&tail);
#endif
	load_start();
	while (n < N_TOTAL) {
		if (sample(n >= CONFIG_LATBENCH_WARMUP, n - CONFIG_LATBENCH_WARMUP)) {
			n++;
		} else if (++n_missed >= MAX_MISSED) {
			printk("LAT ERROR too many samples did not fit the scenario\n");
			break;
		}
	}
	stim_stop();

	printk("LAT META spurious_edges=%u\n", n_spurious);
	printk("LAT META scen_missed=%u\n", n_missed);
	printk("LAT META scen_timeouts=%u\n", n_timeouts);
	stim_print_stats();
	load_print();
#if defined(CONFIG_LATBENCH_IRQ_SCEN_EXIT) || defined(CONFIG_LATBENCH_IRQ_SCEN_BURST)
	lat_hist_print(&h_irq);
#endif
	lat_hist_print(&h_main);
	lat_phase_print(&p_main);
#if defined(CONFIG_LATBENCH_IRQ_SCEN_NESTED)
	lat_hist_print(&h_sw);
#endif
#if defined(CONFIG_LATBENCH_TAIL)
	lat_tail_print(&tail);
#endif
}
```

## src/scenario.h
```c
/*
 * Copyright (c) 2026 inovex GmbH
 *
 * SPDX-License-Identifier: Apache-2.0
 */

/*
 * The scenarios of irq_latency other than the entry
 * (LATBENCH_IRQ_SCENARIO, see scenario.c). main() calls scen_main() after
 * stim_init().
 */

#ifndef IRQ_LATENCY_SCENARIO_H_
#define IRQ_LATENCY_SCENARIO_H_

/** Set up the ISRs, run all samples in the calling thread, print the results. */
void scen_main(void);

#endif /* IRQ_LATENCY_SCENARIO_H_ */
```
