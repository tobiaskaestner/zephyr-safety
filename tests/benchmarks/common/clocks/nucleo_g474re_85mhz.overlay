/*
 * Copyright (c) 2026 inovex GmbH
 *
 * SPDX-License-Identifier: Apache-2.0
 *
 * Core clock 85 MHz: HSE 24 MHz / 6 * 85 / 4. APB1 stays at /1, so TIM2
 * still runs at the core clock. The clock driver sets the flash wait
 * states for the new frequency.
 */

&pll {
	div-r = <4>;
};

&rcc {
	clock-frequency = <DT_FREQ_M(85)>;
};
