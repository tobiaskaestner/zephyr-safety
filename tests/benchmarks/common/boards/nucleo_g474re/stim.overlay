/*
 * Copyright (c) 2026 inovex GmbH
 *
 * SPDX-License-Identifier: Apache-2.0
 *
 * Stimulus of the nucleo_g474re port: TIM2 channel 4 drives D2 (PA10).
 * The loopback wire D2 -> A3 (PB0) takes the edge to the response pin.
 * pwm2 is disabled, because the port programs TIM2 directly.
 */
#include <zephyr/dt-bindings/gpio/gpio.h>
#include <zephyr/dt-bindings/gpio/arduino-header-r3.h>

/ {
	zephyr,user {
		resp-gpios = <&arduino_header ARDUINO_HEADER_R3_A3 GPIO_ACTIVE_HIGH>;
		pinctrl-0 = <&tim2_ch4_pa10>;
		pinctrl-names = "default";
	};
};

&pwm2 {
	status = "disabled";
};
